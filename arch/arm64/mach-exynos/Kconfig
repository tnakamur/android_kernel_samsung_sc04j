## arch/arm64/mach-exynos/Kconfig
```kconfig
# arch/arm64/mach-exynos/Kconfig
#
# Copyright (c) 2016 Samsung Electronics Co., Ltd.
#		http://www.samsung.com/
#
# Licensed under GPLv2

# Configuration options for the EXYNOS7

if ARCH_EXYNOS

menu "SAMSUNG EXYNOS SoCs Support"

choice
	prompt "Exynos device target"
	default MACH_EXYNOS7870_NONE

config MACH_EXYNOS7870_NONE
	bool "None"

config MACH_EXYNOS7870_A3XPREMIUMLTE_JPN_DCM
	bool "Galaxy Feel (SM-A310D)"
	select EXYNOS_DTBTOOL

endchoice

config SKIP_HW_BREAKPOINT
	bool "support skip hw breakpoint"
	default n
	help
	  Support early param for T32 onchip breakpoint

config SEC_BAT_AUT
	bool "Samsung TN Bat Automation Test Feature"
	default n
	help
	  Samsung TN Bat Automation Test

config SAMSUNG_PRODUCT_SHIP
	bool "set up for product shipping"
	default n	  
endmenu

endif
```
